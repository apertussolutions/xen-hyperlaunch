## xen/common/domain-builder/Kconfig
```kconfig
menu "Domain Builder Features"

config BUILDER_FDT
	bool "Domain builder device tree (UNSUPPORTED)" if UNSUPPORTED
	select CORE_DEVICE_TREE
	---help---
	  Enables the ability to configure the domain builder using a
	  flattened device tree.

	  This feature is currently experimental.

	  If unsure, say N.

config MULTIDOM_BUILDER
	bool "Multidomain building (UNSUPPORTED)" if UNSUPPORTED
	depends on BUILDER_FDT
	---help---
	  Enables the domain builder to construct multiple domains.

	  This feature is currently experimental.

	  If unsure, say N.

config BUILDER_HYPFS
	bool "Domain builder hypfs support (UNSUPPORTED)" if UNSUPPORTED
	depends on HYPFS
	---help---
	  Exposes the domain builder construction information
	  through hypfs.

	  This feature is currently experimental.

	  If unsure, say N.

endmenu
```
